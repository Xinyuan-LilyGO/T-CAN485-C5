## main/Kconfig.projbuild
```kconfig
menu "Example Configuration"

    choice
        prompt "Select the example to build"
        default EXAMPLE_BUILD_GENERAL_TEST
            config EXAMPLE_BUILD_WS2812
                bool "ws2812"
            config EXAMPLE_BUILD_SD
                bool "sd"
            config EXAMPLE_BUILD_ADC_DIGITAL_INPUT
                bool "adc_digital_input"
            config EXAMPLE_BUILD_RS485_CAN
                bool "rs485_can"
            config EXAMPLE_BUILD_ETHERNET_IPERF
                bool "ethernet_iperf"
            config EXAMPLE_BUILD_GENERAL_TEST
                bool "general_test"
    endchoice

endmenu
```

## sdkconfig.defaults
```kconfig
CONFIG_IDF_TARGET="esp32c5"
CONFIG_ESPTOOLPY_FLASHSIZE_16MB=y

CONFIG_ETH_ENABLED=y
CONFIG_ETH_USE_SPI_ETHERNET=y
CONFIG_ETH_SPI_ETHERNET_W5500=y

CONFIG_ESP_CONSOLE_USB_SERIAL_JTAG=y
CONFIG_ESP_CONSOLE_SECONDARY_NONE=y

CONFIG_FREERTOS_HZ=1000

CONFIG_PARTITION_TABLE_CUSTOM=y
CONFIG_PARTITION_TABLE_CUSTOM_FILENAME="partitions_esp32c5.csv"
CONFIG_PARTITION_TABLE_FILENAME="partitions_esp32c5.csv"

CONFIG_LILYGO_DEVICE_DRIVER_T_CAN485_C5=y
CONFIG_LILYGO_DEVICE_DRIVER_LOG_LEVEL_INFO=y
```
